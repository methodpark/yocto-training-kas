## conf/distro/training.conf
```bitbake
require conf/distro/poky-tiny.conf


# don't need these added to distro features
DISTRO_FEATURES_BACKFILL_CONSIDERED += "pulseaudio gobject-introspection-data"

# to help avoid all the X11 dependencies maybe
DISTRO_FEATURES:class-native = "pci ipv4 ipv6 usbhost largefile"

PACKAGE_EXCLUDE += "\
  bash \
  bash-completion \
"

SDK_INCLUDE_BUILDTOOLS = "0"

ASSUME_PROVIDED += "\
  python3 \
"

# try to avoid building SDK
TOOLCHAIN_TARGET_TASK = ""
TOOLCHAIN_HOST_TASK = ""

SDK_TARGETS = ""

DISTRO_FEATURES_LIBC = "libc-libm libc-crypt libc-posix-regexp"

# passwordless login
EXTRA_IMAGE_FEATURES += "debug-tweaks"
```

## conf/layer.conf
```bitbake
BBPATH .= ":${LAYERDIR}"
BBFILES += "${LAYERDIR}/*/*/*.bb ${LAYERDIR}/*/*/*.bbappend"
BBFILE_COLLECTIONS += "training"
BBFILE_PATTERN_training := "^${LAYERDIR}/"
BBFILE_PRIORITY_training = "6"

LAYERSERIES_COMPAT_training = "kirkstone"
```
